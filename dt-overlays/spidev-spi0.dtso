// Enable spidev on SPI0
/dts-v1/;
/plugin/;

/ {
	fragment@0 {
		target = <&spi0>;
		__overlay__ {
			status = "okay";
			spi-max-frequency = <50000000>;

			spidev1: spidev@0 {
				compatible = "spidev";
				reg = <0>;
				spi-max-frequency = <50000000>;
			};
		};
	};
};

