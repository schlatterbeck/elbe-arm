// Rotary encoder on PD00 and PD01
// rotary_pins.
/dts-v1/;
/plugin/;

/ {
	fragment@0 {
		target = <&pio>;
		__overlay__ {
			rotary_pins_pd0_pd1: rotary_pd0_pd1 {
				pins = "PD0", "PD1";
				function = "gpio_in";
				bias-pull-up;
			};
		};
	};

	fragment@1 {
                target-path = "/";
		__overlay__ {
			rotary_pd0_pd1 {
				compatible = "rotary-encoder";
				pinctrl-names = "default";
				pinctrl-0 = <&rotary_pins_pd0_pd1>;
				/* PD00 and PD01 */
                                /* Last value 0 is GPIO_ACTIVE_HIGH */
				gpios = <&pio 3 0 0>, <&pio 3 1 0>;
				rotary-encoder,encoding = "gray";
				rotary-encoder,relative-axis;
				interrupt-parent = <&pio>;
                                /* last two values:
                                 * IRQ_TYPE_EDGE_FALLING = 2
                                 * IRQ_TYPE_EDGE_RISING  = 1
                                 */
				interrupts = <3 0 (1 | 2)>, <3 1 (1 | 2)>;
			};
		};
	};
};
