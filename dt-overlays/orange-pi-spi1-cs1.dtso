// Enable CS1 on SPI1 for the orange pi zero
/dts-v1/;
/plugin/;

/ {
	fragment@0 {
		target = <&pio>;
		__overlay__ {
			spi1_cs1: spi1_cs1 {
				pins = "PA10";
				function = "gpio_out";
				output-high;
			};
		};
	};

	fragment@1 {
		target = <&spi1>;
		__overlay__ {
			status = "okay";
                        pinctrl-names = "default", "default";
                        pinctrl-1 = <&spi1_cs1>;
                        /* PA10 GPIO_ACTIVE_HIGH (last 0) */
                        cs-gpios = <0>, <&pio 0 10 0>;
		};
	};
};

