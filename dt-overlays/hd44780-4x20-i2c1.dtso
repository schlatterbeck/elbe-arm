// Use HD44780 with PCF8574 I2C I/O expander on I2C-1
// Note that on most boards another fragment must enable the I2C-1 Bus
/dts-v1/;
/plugin/;

/ {
	fragment@0 {
		target = <&i2c1>;
		__overlay__ {
			#address-cells = <1>;
			#size-cells = <0>;

			display: hd44780@27 {
				compatible = "hit,hd44780+nxp,pcf8575";
				reg = <0x27>;
                                display-height-chars = <4>;
                                display-width-chars  = <20>;
			};
		};
	};
};

