// Enable the I2C-2 Bus
// Not needed for Olimex A20-Olinuxino Micro TARGET=A20-OLinuXino_MICRO

/dts-v1/;
/plugin/;

/ {
	fragment@0 {
		target = <&i2c2>;
		__overlay__ {
                        status = "okay";
		};
	};
};

