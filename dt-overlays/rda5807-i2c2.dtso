// Use RDA5807 Radio on I2C 2
// Note that on most boards another fragment must enable the I2C-2 Bus
/dts-v1/;
/plugin/;

/ {
	fragment@0 {
		target = <&i2c2>;
		__overlay__ {
			#address-cells = <1>;
			#size-cells = <0>;

			radio0: rda5807@11 {
				compatible = "rda,rda5807";
				reg = <0x11>;
			};
		};
	};
};

