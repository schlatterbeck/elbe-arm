// Enable uart2 for the banana-pi m2 berry
/dts-v1/;
/plugin/;

/ {
	fragment@0 {
		target = <&pio>;
		__overlay__ {
			uart2_pi_pins: uart2-pi-pins {
				pins = "PI16", "PI17", "PI18", "PI19";
				function = "uart2";
			};
		};
	};

	fragment@1 {
		target = <&uart2>;
		__overlay__ {
			status = "okay";
                        pinctrl-names = "default";
                        pinctrl-0 = <&uart2_pi_pins>;
		};
	};
};

